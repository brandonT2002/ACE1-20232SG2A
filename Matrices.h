#pragma once
#include "Utilidades.h"

byte numeros[10][8][4] = {{{0, 0, 0, 0},
                           {0, 0, 1, 0},
                           {0, 1, 0, 1},
                           {0, 1, 0, 1},
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                           {0, 0, 0, 0}}};

byte mensaje[24][8][6] = {
    {{0, 0, 0, 0, 0, 0},
     {0, 0, 0, 0, 0, 0},
     {0, 0, 0, 0, 1, 0}, //<
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     {0, 0, 0, 0, 0, 0}}};

void pintarled(int x, int y) {
    if (x < 8)
    {
        digitalWrite(x + 46, HIGH);
        digitalWrite(y, LOW);
        delay(1);
        digitalWrite(x + 46, LOW);
        digitalWrite(y, HIGH);
    }
    else
    {
        driver.setLed(0, y, x - 8, true);
    }
}

void printNumero(int n)
{
    int centenas = int(n / 100);
    int decenas = int((n - centenas * 100) / 10);
    int unidades = int(n - centenas * 100 - decenas * 10);

    for (int x = 0; x < 4; x++)
    {
        for (int y = 0; y < 8; y++)
        {
            if (numeros[centenas][y][x])
            {
                pintarled(x + 1, y);
            }
        }
    }

    for (int x = 0; x < 4; x++)
    {
        for (int y = 0; y < 8; y++)
        {
            if (numeros[decenas][y][x])
            {
                pintarled(x + 6, y);
            }
        }
    }

    for (int x = 0; x < 4; x++)
    {
        for (int y = 0; y < 8; y++)
        {
            if (numeros[unidades][y][x])
            {
                pintarled(x + 11, y);
            }
        }
    }
}

void printMensajeContinuo()
{
    for (int letra = 0; letra < 23; letra++)
    {
        for (int x = 0; x < 6; x++)
        {
            coordx = desfase + x + 6 * letra;
            while (coordx < 0)
            {
                coordx += 138;
            }
            coordx = coordx % 138;
            if (coordx > 15)
            {
                continue;
            }
            for (int y = 0; y < 8; y++)
            {
                if (mensaje[letra][y][x])
                {
                    pintarled(coordx % 138, y);
                }
            }
        }
    }
}

void printMensajeLetra()
{
    if (desfase < 0)
    {
        desfase = 23;
    }

    for (int x = 0; x < 6; x++)
    {
        coordx = 5 + x;
        for (int y = 0; y < 8; y++)
        {
            if (mensaje[desfase % 23][y][x])
            {
                pintarled(coordx, y);
            }
        }
    }
}

void printSerpiente()
{
    Nodo *aux = Serpiente;
    while (aux->activo)
    {
        pintarled(aux->x, aux->y);
        aux = aux->adelante;
    }
}

void printManzana()
{
    pintarled(Manzana->x, Manzana->y);
}